## kconfig
```kconfig
choice
	prompt "Target architecture"
	default TARGET_X86

	config TARGET_X86
		bool "x86"

	config TARGET_X86_64
		bool "x86-64"

	config TARGET_CORTEX_M0
		bool "ARM Cortex-M0"

	config TARGET_CORTEX_M3
		bool "ARM Cortex-M3"

	config TARGET_CORTEX_M4
		bool "ARM Cortex-M4"
endchoice

config PLATFORM
	string
	default x86         if TARGET_X86
	default x86-64      if TARGET_X86_64
	default cortex-m0   if TARGET_CORTEX_M0
	default cortex-m3   if TARGET_CORTEX_M3
	default cortex-m4   if TARGET_CORTEX_M4

menu "Modules"

config CRC_CRC7
	bool "CRC-7"
	default y

config CRC7_BITWISE
	bool "CRC-7 bitwise computation"
	depends on CRC_CRC7

config CRC_CRC8_DALLAS
	bool "CRC-8-Dallas"
	default y

config CRC8_DALLAS_BITWISE
	bool "CRC-8-Dallas bitwise computation"
	depends on CRC_CRC8_DALLAS

config CRC_CRC16_CCITT
	bool "CRC-16-CCITT"
	default y

config CRC16_CCITT_BITWISE
	bool "CRC-16-CCITT bitwise computation"
	depends on CRC_CRC16_CCITT

config CRC_CRC32
	bool "CRC-32"
	default y

config CRC32_BITWISE
	bool "CRC-32 bitwise computation"
	depends on CRC_CRC32

endmenu

menu "Build options"

choice
	prompt "Optimization level"
	default OPTIMIZATIONS_DISABLED

	config OPTIMIZATIONS_DISABLED
		bool "None"

	config OPTIMIZATIONS_SIZE
		bool "Size"

	config OPTIMIZATIONS_FULL
		bool "Full"

	config OPTIMIZATIONS_DEBUG
		bool "Debug"
endchoice

config ASSERTIONS
	bool "Enable assertions"
	depends on (OPTIMIZATIONS_DISABLED || OPTIMIZATIONS_DEBUG)
	default y

config LTO
	bool "Link Time Optimization"
	depends on (OPTIMIZATIONS_SIZE || OPTIMIZATIONS_FULL)
	default y

config FPU
	bool "FPU"
	depends on TARGET_CORTEX_M4
	default y
	help
	  This enables Floating Point Unit.

endmenu

menu "Debug options"
	depends on TARGET_X86 || TARGET_X86_64

config DEBUG
	bool "Enable debug messages"

config EXAMPLES
	bool "Build code examples"
	default y

endmenu
```
